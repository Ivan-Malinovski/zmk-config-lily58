## boards/shields/lily58_dongle/Kconfig.shield
```kconfig
# Copyright (c) 2024 The ZMK Contributors
# SPDX-License-Identifier: MIT

config SHIELD_LILY58_DONGLE
    def_bool $(shields_list_contains,lily58_dongle)
```

## boards/shields/lily58_left_peripheral/Kconfig.defconfig
```kconfig
# Copyright (c) 2024 The ZMK Contributors
# SPDX-License-Identifier: MIT

if SHIELD_LILY58_LEFT_PERIPHERAL

config ZMK_SPLIT
    default y

# ZMK_SPLIT_ROLE_CENTRAL is intentionally NOT set here.
# It will default to n, making this device a peripheral.

endif
```
